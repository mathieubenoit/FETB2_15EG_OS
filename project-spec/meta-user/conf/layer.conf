## project-spec/meta-user/conf/layer.conf
```bitbake
# We have a conf and classes directory, add to BBPATH
BBPATH .= ":${LAYERDIR}"

# We have recipes-* directories, add to BBFILES
BBFILES += "${LAYERDIR}/recipes-*/*/*.bb \
	${LAYERDIR}/recipes-*/*/*.bbappend"

BBFILE_COLLECTIONS += "meta-user"
BBFILE_PATTERN_meta-user = "^${LAYERDIR}/"
BBFILE_PRIORITY_meta-user = "12"
LAYERSERIES_COMPAT_meta-user = "zeus"

PREFERRED_PROVIDER_go-native = "go-binary-native"
PREFERRED_PROVIDER_go-cross = "go-cross_1.17.5"
PREFERRED_VERSION_go= "1.17.5"
PREFERRED_VERSION_go-native= "1.17.5"
PREFERRED_VERSION_go-cross-${TUNE_PKGARCH}= "1.17.5"
PREFERRED_VERSION_go-runtime= "1.17.5"


RM_WORK_EXCLUDE += "gofetb2daq"
```
